## conf/distro/fauxmodore-64.conf
```bitbake
DISTRO_FEATURES = "wayland opengl pam wifi ipv6"
INIT_MANAGER = "systemd"

PACKAGE_CLASSES = "package_ipk"

hostname:pn-base-files = "fauxmodore-64"
```

## conf/layer.conf
```bitbake
BBPATH .= ":${LAYERDIR}"

BBFILES += "\
    ${LAYERDIR}/recipes-*/*/*.bb \
    ${LAYERDIR}/recipes-*/*/*.bbappend \
    "

BBFILE_COLLECTIONS += "fauxmodore-64"
BBFILE_PATTERN_fauxmodore-64 = "^${LAYERDIR}/"
BBFILE_PRIORITY_fauxmodore-64 = "6"

# This should only be incremented on significant changes that will
# cause compatibility issues with other layers
LAYERVERSION_fauxmodore-64 = "1"
LAYERSERIES_COMPAT_fauxmodore-64 = "whinlatter"
```

## wic/sdimage-meson-fauxmodore-64.wks
```
include sdimage-meson.wks
part /var/lib/vice/internal --fstype=vfat --use-uuid --label DATA --align 4096 --size 2G --fsoptions "dmask=000,fmask=111,sync"
```
